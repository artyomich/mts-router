## linux/meta-mts/recipes-bsp/u-boot/files/mts-cr9000_defconfig
```kconfig
# MTS-CR-9000 U-Boot Configuration
CONFIG_ARM=y
CONFIG_TARGET_MTS_CR9000=y
CONFIG_ARCH_X86=y
CONFIG_SYS_TEXT_BASE=0xF0000000
CONFIG_NR_DRAM_BANKS=4
CONFIG_ENV_SIZE=0x10000
CONFIG_DEFAULT_DEVICE_TREE="mts-cr9000"
CONFIG_SYS_LOAD_ADDR=0x2000000
CONFIG_CMD_BOOTZ=y
CONFIG_CMD_BOOTEFI=y
CONFIG_CMD_DHCP=y
CONFIG_CMD_PCI=y
CONFIG_CMD_MTD=y
CONFIG_CMD_USB=y
CONFIG_CMD_GPIO=y
CONFIG_CMD_I2C=y
CONFIG_CMD_SF=y
CONFIG_DM_ETH=y
CONFIG_ETH_INTEL_E1000=y
CONFIG_DM_PCI=y
CONFIG_USB=y
CONFIG_USB_XHCI_HCD=y
CONFIG_USB_EHCI_HCD=y
CONFIG_DM_GPIO=y
CONFIG_I2C=y
CONFIG_DM_I2C=y
CONFIG_SPI=y
CONFIG_DM_SPI=y
CONFIG_SF_DEFAULT_SPEED=50000000
CONFIG_BLK=y
CONFIG_DOS_PARTITION=y
CONFIG_ISO_PARTITION=y
CONFIG_EFI_PARTITION=y
CONFIG_PARTITIONS=y
```
