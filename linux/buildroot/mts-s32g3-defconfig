## linux/meta-mts-openwrt/conf/layer.conf
```bitbake
# Layer configuration for meta-mts-openwrt

# Each layer needs a unique name to avoid conflicts
LAYERSERIES_COMPAT_meta-mts-openwrt = "kirkstone morty langdale"

# Define the layer path
BBPATH .= ":${LAYERDIR}"

# Add recipes to the BBFILES list
BBFILES += "${LAYERDIR}/recipes-*/*/*.bb \
             ${LAYERDIR}/recipes-*/*/*.bbappend \
             ${LAYERDIR}/recipes-*/*/*.inc \
             ${LAYERDIR}/recipes-*/*/*.class \
             ${LAYERDIR}/recipes-*/*/*.ini \
             ${LAYERDIR}/recipes-*/*/*.py \
             ${LAYERDIR}/recipes-*/*/*.sh \
             ${LAYERDIR}/recipes-*/*/*.conf \
             ${LAYERDIR}/recipes-*/*/*.scc \
             ${LAYERDIR}/recipes-*/*/*.bin \
             ${LAYERDIR}/recipes-*/*/*.dtb \
             ${LAYERDIR}/recipes-*/*/*.dts \
             ${LAYERDIR}/recipes-*/*/*.mk \
             ${LAYERDIR}/recipes-*/*/*.txt \
             ${LAYERDIR}/recipes-*/*/*.cfg \
             ${LAYERDIR}/recipes-*/*/*.config"

BBFILE_COLLECTIONS += "meta-mts-openwrt"
BBFILE_PATTERN_meta-mts-openwrt = "^${LAYERDIR}/"
BBFILE_PRIORITY_meta-mts-openwrt = "8"

# Include classes
INHERIT += "mts-openwrt"

# Machine configurations
require conf/machine/include/mts-common.inc

# Kernel configuration
KERNEL_EXTRA_ARGS = "LOADADDR=${KERNEL_LOADADDR}"

# Device tree configurations
DEVICE_TREE = "mts-${MACHINE}"

# OpenWrt specific settings
OPENWRT_TARGET = "mts-${MACHINE}"
OPENWRT_BOARD = "mediatek"

# Firmware paths
MTS_FIRMWARE_DIR = "/lib/firmware/mts"
MTS_DRIVER_DIR = "/lib/modules/${KERNEL_VERSION}/mts"

# Logging configuration
MTS_LOG_DIR = "/var/log/mts"
MTS_LOG_LEVEL = "info"

# Network configuration
MTS_MANAGEMENT_IFACE = "eth0"
MTS_MANAGEMENT_IP = "192.168.1.1"
MTS_MANAGEMENT_NETMASK = "255.255.255.0"
MTS_MANAGEMENT_GATEWAY = "192.168.1.254"
MTS_MANAGEMENT_DNS = "8.8.8.8,8.8.4.4"

# TR-069 configuration
MTS_CWMP_ENABLED = "1"
MTS_CWMP_INTERVAL = "3600"
MTS_CWMP_PORT = "7547"
MTS_CWMP_HTTPS_PORT = "443"
MTS_CWMP_MAX_CONNECTIONS = "10"

# API configuration
MTS_API_ENABLED = "1"
MTS_API_PORT = "50051"
MTS_API_TLS_ENABLED = "1"
MTS_API_MTLS_ENABLED = "1"

# Telemetry configuration
MTS_TELEMETRY_ENABLED = "1"
MTS_TELEMETRY_INTERVAL = "1000"
MTS_TELEMETRY_DELTA_ENCODING = "1"

# SD-WAN configuration (Enterprise)
MTS_SDWAN_ENABLED = "1"
MTS_SDWAN_CONTROLLER = "sdwan.mts-router.local"
MTS_SDWAN_PORT = "443"
MTS_SDWAN_TLS = "1"

# IPTV configuration (Residential)
MTS_IPTV_ENABLED = "1"
MTS_IPTV_PORT = "5004"
MTS_IPTV_PROTO = "igmp"
MTS_IPTV_MAX_SESSIONS = "8"

# VoIP configuration (Residential)
MTS_VOIP_ENABLED = "1"
MTS_VOIP_PROTOCOL = "sip"
MTS_VOIP_PORT = "5060"
MTS_VOIP_TLS_PORT = "5061"
MTS_VOIP_CODECS = "g711a,g711u,g729,g722"

# WiFi configuration (Residential)
MTS_WIFI_ENABLED = "1"
MTS_WIFI_2G_SSID = "MTS-Home-2G"
MTS_WIFI_5G_SSID = "MTS-Home-5G"
MTS_WIFI_2G_CHANNEL = "auto"
MTS_WIFI_5G_CHANNEL = "auto"
MTS_WIFI_2G_BANDWIDTH = "20/40"
MTS_WIFI_5G_BANDWIDTH = "20/40/80"
MTS_WIFI_2G_MODE = "bgn"
MTS_WIFI_5G_MODE = "a/n/ac/ax"
MTS_WIFI_SECURITY = "wpa3-sae"

# GPON configuration (OLT)
MTS_GPON_ENABLED = "1"
MTS_GPON_MAX_PORTS = "8"
MTS_GPON_MAX_ONU = "128"
MTS_GPON_TX_POWER_MIN = "-40"
MTS_GPON_TX_POWER_MAX = "60"
MTS_GPON_MTU = "1500"

# WDM configuration (OLT)
MTS_WDM_ENABLED = "1"
MTS_WDM_MAX_CHANNELS = "4"
MTS_WDM_MONITOR_INTERVAL = "1000"

# P4 Pipeline configuration (OLT)
MTS_P4_ENABLED = "1"
MTS_P4_PIPELINE_DIR = "/etc/mts/p4"
MTS_P4_DEFAULT_PIPELINE = "mts-gpon.p4info.pb"
```

## linux/meta-mts/conf/layer.conf
```bitbake
# Layer configuration for meta-mts
# This layer provides board support for all MTS Router devices

# Declare the layer priority (higher = newer, takes precedence)
LAYERSERIES_COMPAT_meta-mts = "kirkstone langdale litho mickledot"
LAYERSERIES_CORENAMES_meta-mts = "kirkstone langdale litho mickledot"

# Add recipes paths
BBPATH .= ":${LAYERDIR}"

# Provide recipes
BBFILES += "${LAYERDIR}/recipes-*/*/*.bb \
            ${LAYERDIR}/recipes-*/*/*.bbappend"

# Include configuration
CONFDIR .= "${LAYERDIR}/conf"

# Dependencies
LAYDEPENDS += "meta-openembedded/meta-filesystems \
               meta-openembedded/meta-networking \
               meta-openembedded/meta-python \
               meta-virtualization \
               k3s"

# Machine configurations
MACHINECONFDIR = "${LAYERDIR}/conf/machine"

# Classes
INHERIT += "mts-board"

# Image features
IMAGE_FSTYPES_DEFAULT_meta-mts = "ext4 wic.gz"

# Package managers
PACKAGE_CLASSES ?="package_rpm package_deb package-ipk"

# SDK configuration
SDKIMAGE_INSTALL_TASKS_append = " mts-api mts-sdk"
```

## linux/meta-mts/conf/machine/mts-cr9000.conf
```bitbake
# MTS-CR-9000 Core Router Machine Configuration
# Tofino 2 ASIC + AMD EPYC processor
# Yocto-based embedded Linux

DEFAULTTUNE = "x86-64"
MACHINE = "mts-cr9000"
PREFERRED_PROVIDER_virtual/kernel = "linux-mts"
PREFERRED_PROVIDER_virtual/bootloader = "u-boot-mts"

# CPU architecture - TUNE_PKGARCH must match the PACKAGE_ARCH format
TUNE_PKGARCH = "x86_64"
TARGET_ARCH = "x86_64"
TARGET_FPU = ""

# Kernel machine type
KERNEL_MACHINE = "x86_64"

# Root filesystem
IMAGE_FSTYPES = "ext4 wic.gz"
IMAGE_ROOTFS_SIZE = "8388608"
IMAGE_ROOTFS_MAXSIZE = "16777216"
IMAGE_BOOT_FILES = "boot/vmlinuz boot/extlinux/extlinux.conf"

# Package manager
PACKAGE_CLASSES = "package_rpm package_deb"

# Yocto version
PREFERRED_VERSION_linux ?= "6.6%"

# Kernel features
KERNEL_EXTRA_FEATURES = "features/kernel-hardening/kernel-hardening.kl.conf features/virt/virt.kl.conf"

# Filesystem features
IMAGE_FEATURES += "ssh-server-opensysv package-management cmdline-utils sysfs-utils \
    dev-utils tools-debug tools-profile dmesg"

# DPDK support
PACKAGECONFIG_pn-qemu-native = "dpdk"
PACKAGECONFIG_pn-nativesdk-qemu = "dpdk"

# MTS board class override
MTS_BOARD_MODEL = "cr9000"
MTS_BOARD_OS = "yocto"
MTS_BOARD_VENDOR = "MTS Digital"

# Hardware specifics
CPUFLAGS = "-march=x86-64-v2 -mtune=generic -mfpmath=sse -msse4.2"
CORE_IMAGE_BUILD_INSTALL_IMAGES = "1"

# Tofino 2 specific
TOFINO2_DRIVER = "1"
P4RUNTIME_SUPPORT = "1"

# BGP/MPLS support
BGP_SUPPORT = "1"
MPLS_SUPPORT = "1"
SRV6_SUPPORT = "1"

# Timezone and locale
TIMEZONE = "UTC"
TIMEZONEARGS = ""
VARIANT ?= "default"
```

## linux/meta-mts/conf/machine/mts-er1000.conf
```bitbake
# MTS-ER-1000 Enterprise Router Machine Configuration
# NXP S32G3 ARM64 + TomTom switch
# OpenWrt-based embedded Linux

require conf/machine/include/arm32/uninext-arm32.inc

# Machine definition
MACHINE = "mts-er1000"
PREFERRED_PROVIDER_virtual/kernel = "linux-mts"
PREFERRED_PROVIDER_virtual/bootloader = "u-boot-mts"

# CPU architecture
TARGET_ARCH = "arm"
TARGET_OS = "linux"
TUNE_ARCH = "arm"
TUNE_PKGARCH = "armv8a+crypto"

# Kernel machine type
KERNEL_MACHINE = "arm"

# Root filesystem
IMAGE_FSTYPES = "squashfs ext4 wic.gz"
IMAGE_ROOTFS_SIZE = "4194304"
IMAGE_ROOTFS_MAXSIZE = "8388608"
IMAGE_BOOT_FILES = "boot/vmlinuz boot/extlinux/extlinux.conf"

# Package manager
PACKAGE_CLASSES = "package_ipk"

# OpenWrt configuration
OPENWRT_SUPPORT = "1"
OPENWRT_VERSION = "23.05"
OPENWRT_TARGET = "arm/armv7"
OPENWRT_SUBTARGET = "nxp_s32g"

# Yocto version
PREFERRED_VERSION_linux ?= "6.1%"

# Kernel features
KERNEL_EXTRA_FEATURES = "features/kernel-hardening/kernel-hardening.kl.conf"

# Filesystem features
IMAGE_FEATURES += "ssh-server-opensysv package-management cmdline-utils"

# MTS board class override
MTS_BOARD_MODEL = "er1000"
MTS_BOARD_OS = "openwrt"
MTS_BOARD_VENDOR = "MTS Digital"

# Hardware specifics
CPUFLAGS = "-mcpu=cortex-a53+crc+crypto -mfpu=neon-fp-armv8 -mfloat-abi=hard -mfpu=neon-vfpv4"
CORE_IMAGE_BUILD_INSTALL_IMAGES = "1"

# S32G3 specific
S32G3_DRIVER = "1"
S32G3_SDK = "1"

# TomTom switch specific
TOMTOM_SWITCH = "1"
TOMTOM_DRIVER = "1"

# SD-WAN support
SDWAN_SUPPORT = "1"
SDWAN_ENGINE = "strongswan"
STRONGSWAN_VERSION = "6.0"

# BGP/MPLS support
BGP_SUPPORT = "1"
MPLS_SUPPORT = "1"
FRR_SUPPORT = "1"
FRR_VERSION = "9.0"

# IPSec support
IPSEC_SUPPORT = "1"
IPSEC_DAEMON = "strongswan"

# Timezone and locale
TIMEZONE = "UTC"
TIMEZONEARGS = ""
VARIANT ?= "default"
```

## linux/meta-mts/conf/machine/mts-mb3000.conf
```bitbake
# MTS-MB-3000 Mobile Backhaul Machine Configuration
# NXP S32G3 ARM64 + 88Q5242 switch
# Buildroot-based embedded Linux

require conf/machine/include/arm32/uninext-arm32.inc

# Machine definition
MACHINE = "mts-mb3000"
PREFERRED_PROVIDER_virtual/kernel = "linux-mts"
PREFERRED_PROVIDER_virtual/bootloader = "u-boot-mts"

# CPU architecture
TARGET_ARCH = "arm"
TARGET_OS = "linux"
TUNE_ARCH = "arm"
TUNE_MACHDEP = "fsl-layer"
TUNE_PKGARCH = "armv8a+crypto"

# Kernel machine type
KERNEL_MACHINE = "arm"

# Root filesystem
IMAGE_FSTYPES = "ext4.gz wic.gz"
IMAGE_ROOTFS_SIZE = "4194304"
IMAGE_ROOTFS_MAXSIZE = "8388608"
IMAGE_BOOT_FILES = "boot/vmlinuz boot/extlinux/extlinux.conf"

# Package manager
PACKAGE_CLASSES = "package_rpm package_deb package-ipk"

# Yocto version
PREFERRED_VERSION_linux ?= "6.1%"

# Kernel features
KERNEL_EXTRA_FEATURES = "features/kernel-hardening/kernel-hardening.kl.conf"

# Filesystem features
IMAGE_FEATURES += "ssh-server-opensysv package-management cmdline-utils"

# Buildroot configuration
BUILDROOT_SUPPORT = "1"
BUILDROOT_VERSION = "2024.02"
BUILDROOT_CONFIG = "board/mts/s32g3_defconfig"

# DPDK support
DPDK_SUPPORT = "1"
DPDK_VERSION = "23.11"
DPDK_TARGET = "x86_64-native"

# MTS board class override
MTS_BOARD_MODEL = "mb3000"
MTS_BOARD_OS = "buildroot"
MTS_BOARD_VENDOR = "MTS Digital"

# Hardware specifics
CPUFLAGS = "-mcpu=cortex-a53+crc+crypto -mfpu=neon-fp-armv8 -mfloat-abi=hard -mfpu=neon-vfpv4"
CORE_IMAGE_BUILD_INSTALL_IMAGES = "1"

# S32G3 specific
S32G3_DRIVER = "1"
S32G3_SDK = "1"

# MPLS-TP support
MPLS_TP_SUPPORT = "1"
MPLS_TP_VERSION = "1.0"

# PTP grandmaster
PTP_SUPPORT = "1"
PTP_DAEMON = "linuxptp"
PTP_VERSION = "4.0"

# SyncE support
SYNCE_SUPPORT = "1"

# Timezone and locale
TIMEZONE = "UTC"
TIMEZONEARGS = ""
VARIANT ?= "default"
```

## linux/meta-mts/conf/machine/mts-mc5000.conf
```bitbake
# MTS-MC-5000 Mobile Core Machine Configuration
# ThunderX3 ARM64 + AMD EPYC processor
# Yocto-based embedded Linux with K3s

require conf/machine/include/arm64/uninext-arm64.inc

# Machine definition
MACHINE = "mts-mc5000"
PREFERRED_PROVIDER_virtual/kernel = "linux-mts"
PREFERRED_PROVIDER_virtual/bootloader = "u-boot-mts"

# CPU architecture
TARGET_ARCH = "aarch64"
TARGET_OS = "linux"
TUNE_AARCH64_CORE = "cortex-a76"
TUNE_PKGARCH = "aarch64"

# Kernel machine type
KERNEL_MACHINE = "arm64"

# Root filesystem
IMAGE_FSTYPES = "ext4 wic.gz"
IMAGE_ROOTFS_SIZE = "10485760"
IMAGE_ROOTFS_MAXSIZE = "20971520"
IMAGE_BOOT_FILES = "boot/vmlinuz boot/extlinux/extlinux.conf"

# Package manager
PACKAGE_CLASSES = "package_rpm package_deb"

# Yocto version
PREFERRED_VERSION_linux ?= "6.6%"

# Kernel features
KERNEL_EXTRA_FEATURES = "features/kernel-hardening/kernel-hardening.kl.conf features/virt/virt.kl.conf"

# Filesystem features
IMAGE_FEATURES += "ssh-server-opensysv package-management cmdline-utils sysfs-utils \
    dev-utils tools-debug tools-profile dmesg"

# K3s (Kubernetes) support
K3S_SUPPORT = "1"
K3S_VERSION = "1.28.0"
CONTAINER_RUNTIME = "containerd"
CNI_PLUGINS_VERSION = "1.4.0"

# DPDK support
PACKAGECONFIG_pn-qemu-native = "dpdk"
PACKAGECONFIG_pn-nativesdk-qemu = "dpdk"

# MTS board class override
MTS_BOARD_MODEL = "mc5000"
MTS_BOARD_OS = "yocto"
MTS_BOARD_VENDOR = "MTS Digital"

# Hardware specifics
CPUFLAGS = "-mcpu=cortex-a76+crc -fpie -fPIE"
CORE_IMAGE_BUILD_INSTALL_IMAGES = "1"

# ThunderX3 specific
THUNDERX3_DRIVER = "1"
UPF_SUPPORT = "1"
SMF_SUPPORT = "1"
AMF_SUPPORT = "1"
PCF_SUPPORT = "1"

# 5G specific
GTP_SUPPORT = "1"
PFCP_SUPPORT = "1"
SWA_SUPPORT = "1"

# Timezone and locale
TIMEZONE = "UTC"
TIMEZONEARGS = ""
VARIANT ?= "default"
```

## linux/meta-mts/conf/machine/mts-olt2000.conf
```bitbake
# MTS-OLT-2000 OLT GPON Machine Configuration
# Tofino 2 ASIC + AMD EPYC processor
# OpenWrt-based embedded Linux

require conf/machine/include/uninext-board.inc

# Machine definition
MACHINE = "mts-olt2000"
PREFERRED_PROVIDER_virtual/kernel = "linux-mts"
PREFERRED_PROVIDER_virtual/bootloader = "u-boot-mts"

# CPU architecture
TARGET_ARCH = "x86-64"
TARGET_FPU = ""
TUNE_PKGARCH = "x86-64-v2"

# Kernel machine type
KERNEL_MACHINE = "x86_64"

# Root filesystem
IMAGE_FSTYPES = "squashfs ext4 wic.gz"
IMAGE_ROOTFS_SIZE = "6291456"
IMAGE_ROOTFS_MAXSIZE = "12582912"
IMAGE_BOOT_FILES = "boot/vmlinuz boot/extlinux/extlinux.conf"

# Package manager
PACKAGE_CLASSES = "package_ipk"

# OpenWrt configuration
OPENWRT_SUPPORT = "1"
OPENWRT_VERSION = "23.05"
OPENWRT_TARGET = "x86/64"
OPENWRT_SUBTARGET = "generic"

# Yocto version
PREFERRED_VERSION_linux ?= "6.6%"

# Kernel features
KERNEL_EXTRA_FEATURES = "features/kernel-hardening/kernel-hardening.kl.conf"

# Filesystem features
IMAGE_FEATURES += "ssh-server-opensysv package-management cmdline-utils"

# MTS board class override
MTS_BOARD_MODEL = "olt2000"
MTS_BOARD_OS = "openwrt"
MTS_BOARD_VENDOR = "MTS Digital"

# Hardware specifics
CPUFLAGS = "-march=x86-64-v2 -mtune=generic -mfpmath=sse -msse4.2"
CORE_IMAGE_BUILD_INSTALL_IMAGES = "1"

# Tofino 2 specific
TOFINO2_DRIVER = "1"
P4RUNTIME_SUPPORT = "1"

# GPON specific
GPON_SUPPORT = "1"
GPON_CHIP = "rtl960x"
RTL960X_DRIVER = "1"
OMCI_SUPPORT = "1"
TR069_SUPPORT = "1"
CWMPD_VERSION = "1.10"

# WiFi support (optional uplink)
WIFI_SUPPORT = "1"
WIFI_CHIP = "mt76"

# Timezone and locale
TIMEZONE = "UTC"
TIMEZONEARGS = ""
VARIANT ?= "default"
```

## linux/meta-mts/conf/machine/mts-rg500.conf
```bitbake
# MTS-RG-500 Residential Gateway Machine Configuration
# MediaTek MT7981 ARM64 + RTL960x GPON
# OpenWrt-based embedded Linux

require conf/machine/include/arm64/uninext-arm64.inc

# Machine definition
MACHINE = "mts-rg500"
PREFERRED_PROVIDER_virtual/kernel = "linux-mts"
PREFERRED_PROVIDER_virtual/bootloader = "u-boot-mts"

# CPU architecture
TARGET_ARCH = "aarch64"
TARGET_OS = "linux"
TUNE_PKGARCH = "aarch64"

# Kernel machine type
KERNEL_MACHINE = "arm64"

# Root filesystem
IMAGE_FSTYPES = "ext4.gz wic.gz"
IMAGE_ROOTFS_SIZE = "2097152"
IMAGE_ROOTFS_MAXSIZE = "4194304"
IMAGE_BOOT_FILES = "boot/vmlinuz boot/extlinux/extlinux.conf"

# Package manager
PACKAGE_CLASSES = "package_ipk"

# OpenWrt configuration
OPENWRT_SUPPORT = "1"
OPENWRT_VERSION = "23.05"
OPENWRT_TARGET = "mediatek/mt7981"
OPENWRT_SUBTARGET = "mt7981"

# Yocto version
PREFERRED_VERSION_linux ?= "6.1%"

# Kernel features
KERNEL_EXTRA_FEATURES = "features/kernel-hardening/kernel-hardening.kl.conf"

# Filesystem features
IMAGE_FEATURES += "ssh-server-opensysv package-management cmdline-utils"

# MTS board class override
MTS_BOARD_MODEL = "rg500"
MTS_BOARD_OS = "openwrt"
MTS_BOARD_VENDOR = "MTS Digital"

# Hardware specifics
CPUFLAGS = "-mcpu=cortex-a72+crc+crypto -fpie -fPIE"
CORE_IMAGE_BUILD_INSTALL_IMAGES = "1"

# MT7981 specific
MT7981_DRIVER = "1"
MT7981_SDK = "1"
MT7981_ARCH = "armv8"

# RTL960x GPON specific
RTL960X_DRIVER = "1"
GPON_SUPPORT = "1"
OMCI_SUPPORT = "1"

# WiFi 6 support (MT76)
WIFI_SUPPORT = "1"
WIFI_CHIP = "mt76"
WIFI_STANDARD = "802.11ax"
WIFI_FREQ = "2.4GHz+5GHz"
MT76_FIRMWARE = "1"

# VoIP support
VOIP_SUPPORT = "1"
VOIP_DAEMON = "asterisk"
ASTERISK_VERSION = "21.0"
SIP_PROTOCOL = "pjsip"

# IPTV support
IPTV_SUPPORT = "1"
IGMP_PROXY = "1"
PPP_SUPPORT = "1"

# TR-069 support
TR069_SUPPORT = "1"
CWMPD_VERSION = "1.10"

# Timezone and locale
TIMEZONE = "UTC"
TIMEZONEARGS = ""
VARIANT ?= "default"
```
